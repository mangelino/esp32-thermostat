## main/Kconfig.projbuild
```kconfig
menu "Bee Monitor Configuration"

    config ESP_WIFI_SSID
        string "WiFi SSID"
        default "myssid"
        help
            SSID (network name) for the example to connect to.

    config ESP_WIFI_PASSWORD
        string "WiFi Password"
        default "mypassword"
        help
            WiFi password (WPA or WPA2) for the example to use.

    config ESP_MAXIMUM_RETRY
        int "Maximum retry"
        default 5
        help
            Set the Maximum retry to avoid station reconnecting to the AP unlimited when the AP is really inexistent.
    
    config ESP_MQTT_BROKER
        string "MQTT Broker FQDN"
        default "xxx-ats.iot.eu-west-1.aws.amazon.com"
        help
            MQTT Broker FQDN
    
    config ESP_CLIENT_ID
        string "MQTT Client ID"
        default "client"
        help
            MQTT Client ID
    
    config POLLING_PERIOD_MS
        int "Polling period (ms)"
        default 30000
        help
            The sensors polling period in millis
endmenu
```
